## package/dosbox-staging/Config.in
```kconfig
config BR2_PACKAGE_DOSBOX_STAGING
    bool "dosbox-staging (SDL2)"
    depends on BR2_INSTALL_LIBSTDCPP
    depends on BR2_TOOLCHAIN_HAS_THREADS
    depends on BR2_PACKAGE_IIR
    select BR2_PACKAGE_SDL2
    help
      Modernized DOSBox fork with SDL2.
      https://dosbox-staging.github.io
```

## package/iir/Config.in
```kconfig
config BR2_PACKAGE_IIR
    bool "iir"
    help
      DSP IIR filter library (used by dosbox-staging)
```

## package/libpngx/Config.in
```kconfig
config BR2_PACKAGE_LIBPNG
    bool "libpngx"
    select BR2_PACKAGE_ZLIB
    help
      libpng library (used by dosbox-staging)
```

## package/nesemu2/Config.in
```kconfig
config BR2_PACKAGE_NESEMU2
    bool "nesemu2"
    select BR2_PACKAGE_SDL
    select BR2_PACKAGE_SDL_FBCON
    help
      NesEmu2
```

## package/nos/Config.in
```kconfig
config BR2_PACKAGE_NOS
    bool "nos"
    select BR2_PACKAGE_SDL2
    help
      Nos
```

## package/snes9x/Config.in
```kconfig
config BR2_PACKAGE_SNES9X
    bool "snes9x"
    select BR2_PACKAGE_SDL
    select BR2_PACKAGE_SDL_FBCON
    help
      Snes9x
```
